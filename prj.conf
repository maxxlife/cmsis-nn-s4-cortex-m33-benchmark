## CMakeLists.txt
```
cmake_minimum_required(VERSION 3.20.0)
set(CMAKE_EXPORT_COMPILE_COMMANDS ON)
find_package(Zephyr REQUIRED HINTS $ENV{ZEPHYR_BASE})
project(cmsis_nn_s4_rowtiling C)

if(NOT CONFIG_CPU_CORTEX_M33)
  message(FATAL_ERROR "This experiment targets Cortex-M33 with DSP extensions")
endif()

target_sources(app PRIVATE src/main.c src/kernels.c)
target_include_directories(app PRIVATE
  src
  ${ZEPHYR_CMSIS_NN_MODULE_DIR}/Source/NNSupportFunctions
)
# Source options are emitted after Zephyr's inherited -O2.
set_property(SOURCE src/main.c src/kernels.c APPEND PROPERTY
  COMPILE_OPTIONS "$<TARGET_PROPERTY:compiler,optimization_fast>")

execute_process(COMMAND git -C ${ZEPHYR_CMSIS_NN_MODULE_DIR} rev-parse HEAD
  OUTPUT_VARIABLE BENCH_CMSIS_REV OUTPUT_STRIP_TRAILING_WHITESPACE
  ERROR_QUIET)
if(NOT BENCH_CMSIS_REV)
  set(BENCH_CMSIS_REV "unknown")
endif()
configure_file(src/build_info.h.in ${CMAKE_CURRENT_BINARY_DIR}/build_info.h @ONLY)
target_include_directories(app PRIVATE ${CMAKE_CURRENT_BINARY_DIR})
```

## prj.conf
```kconfig
CONFIG_CMSIS_NN=y
CONFIG_CMSIS_NN_NNSUPPORT=y
CONFIG_SPEED_OPTIMIZATIONS=y
CONFIG_LTO=n
CONFIG_MAIN_STACK_SIZE=4096
CONFIG_SERIAL=y
CONFIG_CONSOLE=y
CONFIG_UART_CONSOLE=y
CONFIG_PRINTK=y
CONFIG_LOG=n
CONFIG_ASSERT=y
```

## src/main.c
```c
/* SPDX-License-Identifier: Apache-2.0 */
#include <stdint.h>
#include <string.h>
#include "bench.h"

#ifdef BENCH_HOST_TEST
#include <stdio.h>
#define PRINT printf
#else
#include <zephyr/kernel.h>
#include <zephyr/irq.h>
#include <zephyr/sys/printk.h>
#include <cmsis_core.h>
#include <nrfx.h>
#include <hal/nrf_cache.h>
#include <hal/nrf_rramc.h>
#include "arm_nnsupportfunctions.h"
#include "build_info.h"
#include "rram_weights.h"
#define PRINT printk
#endif

#define MAX_ROWS 256
#define MAX_COLS 512
#define GUARD 4
#define SAMPLES 31
#define KERNEL_COUNT 10

static int8_t x_storage[MAX_COLS + 4] __attribute__((aligned(4)));
static int8_t weight_storage[MAX_ROWS * MAX_COLS / 2 + 4] __attribute__((aligned(4)));
static int32_t biases[MAX_ROWS];
static int8_t out_storage[MAX_ROWS + 2 * GUARD];
static int8_t expected[MAX_ROWS];
static uint32_t samples[KERNEL_COUNT][SAMPLES];
static volatile uint32_t output_sink;

static const struct {
    const char *name;
    bench_kernel_fn run;
} kernels[KERNEL_COUNT] = {
    {"cmsis_stock", bench_cmsis},
    {"cmsis_u16_or", bench_cmsis_u16_or},
    {"tile1", bench_tile1},
    {"tile2", bench_tile2},
    {"tile2_u16_mask", bench_tile2_u16_mask},
    {"tile2_u16_or", bench_tile2_u16_or},
    {"tile4", bench_tile4},
    {"tile4_u16_mask", bench_tile4_u16_mask},
    {"tile4_u16_or", bench_tile4_u16_or},
    {"tile4_u16_or_nospill", bench_tile4_u16_or_nospill},
};

static uint32_t random_next(uint32_t *state)
{
    uint32_t x = *state;
    x ^= x << 13;
    x ^= x >> 17;
    x ^= x << 5;
    *state = x;
    return x;
}

static struct bench_args make_args(int rows, int cols)
{
    const struct bench_args p = {
        .x = x_storage, .weights = weight_storage, .bias = biases,
        .out = out_storage + GUARD, .rows = rows, .cols = cols,
        .input_offset = 0, .output_offset = 0,
        .multiplier = 0x40000000, .shift = -8,
        .activation_min = -128, .activation_max = 127,
    };
    return p;
}

static void fill_inputs(struct bench_args *p, uint32_t seed, int pattern, int misaligned)
{
    p->x = x_storage + misaligned;
    p->weights = weight_storage + misaligned;
    int8_t *x = x_storage + misaligned;
    int8_t *w = weight_storage + misaligned;
    uint32_t state = seed ? seed : 1;
    for (int i = 0; i < p->cols; ++i) {
        x[i] = pattern == 1 ? (i & 1 ? 127 : -128) :
            pattern == 2 ? 0 : (int8_t)(random_next(&state) >> 24);
    }
    for (int i = 0; i < (p->rows * p->cols + 1) / 2; ++i) {
        w[i] = pattern == 1 ? 0x78 : pattern == 2 ? 0 :
            (int8_t)(random_next(&state) >> 24);
    }
    for (int i = 0; i < p->rows; ++i) {
        biases[i] = (int32_t)(random_next(&state) % 65537) - 32768;
    }
}

static void prepare_expected(const struct bench_args *p)
{
    struct bench_args reference = *p;
    reference.out = expected;
    bench_reference(&reference);
}

static int verify(const struct bench_args *p, int which)
{
    for (int i = 0; i < p->rows; ++i) {
        if (p->out[i] != expected[i]) {
            PRINT("FAIL,kernel=%s,rows=%d,cols=%d,offset=%d,row=%d,got=%d,expected=%d\n",
                  kernels[which].name, (int)p->rows, (int)p->cols,
                  (int)p->input_offset, i, p->out[i], expected[i]);
            return 0;
        }
    }
    for (int i = 0; i < GUARD; ++i) {
        if ((uint8_t)out_storage[i] != 0x5a ||
            (uint8_t)out_storage[GUARD + p->rows + i] != 0x5a) {
            PRINT("FAIL,output_guard,kernel=%s\n", kernels[which].name);
            return 0;
        }
    }
    return 1;
}

static int correctness_suite(void)
{
    uint32_t bad_u16 = 0;
    if (!bench_check_unpack_all_u16(&bad_u16)) {
        PRINT("FAIL,unpack_u16,input=0x%04x\n", (unsigned)bad_u16);
        return 0;
    }
    PRINT("UNPACK_U16,PASS,inputs=65536\n");

    static const int shapes[][2] = {
        {1, 1}, {2, 3}, {3, 2}, {4, 4}, {5, 7}, {7, 8},
        {8, 15}, {9, 16}, {17, 31}, {17, 32}, {64, 64},
        {128, 256}, {256, 256}, {128, 512}, {256, 512}, {255, 257},
    };
    static const int offsets[] = {0, -127, 128, 37};
    unsigned cases = 0;
    for (unsigned s = 0; s < sizeof(shapes) / sizeof(shapes[0]); ++s) {
        for (unsigned o = 0; o < sizeof(offsets) / sizeof(offsets[0]); ++o) {
            for (int use_bias = 0; use_bias < 2; ++use_bias) {
                for (int q = 0; q < 3; ++q) {
                    for (int pattern = 0; pattern < 3; ++pattern) {
                        struct bench_args p = make_args(shapes[s][0], shapes[s][1]);
                        fill_inputs(&p, 0x142857u + cases * 7919u, pattern, cases & 1);
                        p.input_offset = offsets[o];
                        p.bias = use_bias ? biases : NULL;
                        if (q == 1) {
                            p.multiplier = 0x60000000;
                            p.shift = -3;
                            p.output_offset = -9;
                            p.activation_min = -17;
                            p.activation_max = 23;
                        } else if (q == 2) {
                            p.shift = 1;
                            p.output_offset = 17;
                        }
                        prepare_expected(&p);
                        for (int k = 0; k < KERNEL_COUNT; ++k) {
                            memset(out_storage, 0x5a, sizeof(out_storage));
                            kernels[k].run(&p);
                            if (!verify(&p, k)) {
                                PRINT("FAIL,case=%u,pattern=%d,quant=%d,bias=%d\n",
                                      cases, pattern, q, use_bias);
                                return 0;
                            }
                        }
                        ++cases;
                    }
                }
            }
        }
        PRINT("CHECK,rows=%d,cols=%d,PASS\n", shapes[s][0], shapes[s][1]);
    }
    PRINT("CORRECTNESS,PASS,cases=%u,kernels=%d\n", cases, KERNEL_COUNT);
    return 1;
}

#ifndef BENCH_HOST_TEST
static int enable_cycle_counter(void)
{
    CoreDebug->DEMCR |= CoreDebug_DEMCR_TRCENA_Msk;
    __DSB();
    __ISB();
    if (DWT->CTRL & DWT_CTRL_NOCYCCNT_Msk) {
        return 0;
    }
    DWT->CYCCNT = 0;
    DWT->CTRL |= DWT_CTRL_CYCCNTENA_Msk;
    __DSB();
    __ISB();
    const uint32_t start = DWT->CYCCNT;
    for (volatile unsigned i = 0; i < 100; ++i) {
        __NOP();
    }
    return DWT->CYCCNT != start;
}

static uint32_t time_kernel_with_cache(bench_kernel_fn run,
                                       const struct bench_args *p,
                                       uint32_t *hits_out,
                                       uint32_t *misses_out)
{
    unsigned int key = irq_lock();
#if defined(CACHE_PROFILINGENABLE_ENABLE_Msk)
    NRF_ICACHE->PROFILINGENABLE = 0;
    NRF_ICACHE->PROFILINGCLEAR = 1;
    NRF_ICACHE->PROFILINGENABLE = 1;
#endif
    __DSB();
    __ISB();
    __asm__ volatile("" ::: "memory");
    const uint32_t begin = DWT->CYCCNT;
    __asm__ volatile("" ::: "memory");
    run(p);
    __asm__ volatile("" ::: "memory");
    __DSB();
    const uint32_t end = DWT->CYCCNT;
#if defined(CACHE_PROFILINGENABLE_ENABLE_Msk)
    NRF_ICACHE->PROFILINGENABLE = 0;
    if (hits_out) {
        *hits_out = NRF_ICACHE->HIT;
    }
    if (misses_out) {
        *misses_out = NRF_ICACHE->MISS;
    }
#else
    if (hits_out) *hits_out = 0;
    if (misses_out) *misses_out = 0;
#endif
    __asm__ volatile("" ::: "memory");
    irq_unlock(key);
    return end - begin;
}

static uint32_t time_kernel(bench_kernel_fn run, const struct bench_args *p)
{
    return time_kernel_with_cache(run, p, NULL, NULL);
}

static void empty_kernel(const struct bench_args *p)
{
    (void)p;
    __asm__ volatile("" ::: "memory");
}

static void sort_samples(uint32_t *v, unsigned n)
{
    for (unsigned i = 1; i < n; ++i) {
        const uint32_t x = v[i];
        unsigned j = i;
        while (j && v[j - 1] > x) {
            v[j] = v[j - 1];
            --j;
        }
        v[j] = x;
    }
}

static uint32_t checksum(const struct bench_args *p)
{
    uint32_t hash = 2166136261u;
    for (int i = 0; i < p->rows; ++i) {
        hash = (hash ^ (uint8_t)p->out[i]) * 16777619u;
    }
    return hash;
}

static int benchmark_shape(int rows, int cols, int offset)
{
    struct bench_args p = make_args(rows, cols);
    fill_inputs(&p, 0x98765432u + rows * 123u + cols, 0, 0);
    p.input_offset = offset;
    prepare_expected(&p);
    memset(out_storage, 0x5a, sizeof(out_storage));
    for (int k = 0; k < KERNEL_COUNT; ++k) {
        for (int w = 0; w < 5; ++w) {
            kernels[k].run(&p);
        }
    }
    for (int s = 0; s < SAMPLES; ++s) {
        for (int j = 0; j < KERNEL_COUNT; ++j) {
            const int k = (s + j) % KERNEL_COUNT;
            kernels[k].run(&p);
            samples[k][s] = time_kernel(kernels[k].run, &p);
            if (!verify(&p, k)) {
                return 0;
            }
            output_sink ^= checksum(&p);
        }
    }
    for (int k = 0; k < KERNEL_COUNT; ++k) {
        PRINT("RAW,%d,%d,%d,%s", rows, cols, offset, kernels[k].name);
        for (int s = 0; s < SAMPLES; ++s) {
            PRINT(",%u", (unsigned)samples[k][s]);
        }
        PRINT("\n");
        sort_samples(samples[k], SAMPLES);
        PRINT("RESULT,%d,%d,%d,%s,%u,%u,%u,%08x\n", rows, cols, offset,
              kernels[k].name, (unsigned)samples[k][0],
              (unsigned)samples[k][SAMPLES / 2], (unsigned)samples[k][SAMPLES - 1],
              (unsigned)checksum(&p));
    }
    return 1;
}

static int benchmark_rram_suite(const char *mode_label)
{
    static const int rram_kernels[] = {0, 1, 5, 8, 9}; /* stock, cmsis_u16_or, tile2_C, tile4_C, tile4_C_nospill */
    static const int shapes[][2] = {{64, 64}, {128, 256}, {256, 256}, {128, 512}, {256, 512}};
    const unsigned rram_samples = 11;

    for (unsigned s = 0; s < sizeof(shapes) / sizeof(shapes[0]); ++s) {
        const int rows = shapes[s][0];
        const int cols = shapes[s][1];
        struct bench_args p = make_args(rows, cols);
        fill_inputs(&p, 0x98765432u + rows * 123u + cols, 0, 0);
        p.weights = rram_weight_storage;
        p.input_offset = 37;
        prepare_expected(&p);
        memset(out_storage, 0x5a, sizeof(out_storage));

        for (unsigned idx = 0; idx < sizeof(rram_kernels) / sizeof(rram_kernels[0]); ++idx) {
            const int k = rram_kernels[idx];
            uint32_t cyc[11];
            uint32_t last_hits = 0, last_misses = 0;
            kernels[k].run(&p);
            if (!verify(&p, k)) {
                return 0;
            }
            for (unsigned r = 0; r < rram_samples; ++r) {
                cyc[r] = time_kernel_with_cache(kernels[k].run, &p, &last_hits, &last_misses);
                output_sink ^= checksum(&p);
            }
            sort_samples(cyc, rram_samples);
            PRINT("RRAM_RESULT,%s,%d,%d,%s,min=%u,med=%u,max=%u,icache_hit=%u,icache_miss=%u\n",
                  mode_label, rows, cols, kernels[k].name,
                  (unsigned)cyc[0], (unsigned)cyc[rram_samples / 2], (unsigned)cyc[rram_samples - 1],
                  (unsigned)last_hits, (unsigned)last_misses);
        }
    }
    return 1;
}
#endif

int main(void)
{
#ifdef BENCH_HOST_TEST
    PRINT("HOST_TEST: scalar CMSIS-NN + software model of DSP operations; no timing claims\n");
#else
    k_msleep(2000);
    PRINT("\nS4_ROWTILING,v0.4\n");
    PRINT("BOARD,%s\nCMSIS_NN,%s\nCOMPILER,%s\n", BENCH_BOARD, BENCH_CMSIS_REV, __VERSION__);
    PRINT("TIMING,DWT_CYCCNT,raw_cycles,IRQs_masked,warm_code,data_in_SRAM\n");
    PRINT("FEATURES,ARM_MATH_DSP=1,MVE=0\n");
#ifdef CMSIS_NN_USE_SINGLE_ROUNDING
    PRINT("REQUANTIZE,single_rounding\n");
#else
    PRINT("REQUANTIZE,double_rounding\n");
#endif
    PRINT("CORRECTNESS,START\n");
#endif
    if (!correctness_suite()) {
        return 1;
    }
#ifdef BENCH_HOST_TEST
    return 0;
#else
    if (!enable_cycle_counter()) {
        PRINT("ERROR,DWT_CYCCNT_unavailable; no performance results\n");
        return 1;
    }
    struct bench_args dummy = make_args(1, 4);
    uint32_t overhead = UINT32_MAX;
    for (int i = 0; i < SAMPLES; ++i) {
        const uint32_t value = time_kernel(empty_kernel, &dummy);
        overhead = MIN(overhead, value);
    }
    PRINT("TIMER_OVERHEAD,min_cycles=%u,not_subtracted\n", (unsigned)overhead);
    PRINT("COLUMNS,rows,cols,input_offset,kernel,min_cycles,median_cycles,max_cycles,checksum\n");
    const int shapes[][2] = {{64, 64}, {128, 256}, {256, 256}, {128, 512}, {256, 512}};
    for (unsigned s = 0; s < sizeof(shapes) / sizeof(shapes[0]); ++s) {
        if (!benchmark_shape(shapes[s][0], shapes[s][1], 0) ||
            !benchmark_shape(shapes[s][0], shapes[s][1], 37)) {
            return 1;
        }
    }

    PRINT("MEM_ADDR,rram_weights=0x%08x,sram_weights=0x%08x,ICACHE_ENABLE=%u,RRAMC_LOWPOWER=0x%08x,RRAMC_STANDBY=0x%08x\n",
          (unsigned)(uintptr_t)rram_weight_storage,
          (unsigned)(uintptr_t)weight_storage,
          (unsigned)NRF_ICACHE->ENABLE,
          (unsigned)NRF_RRAMC->POWER.LOWPOWERCONFIG,
          (unsigned)NRF_RRAMC->POWER.STANDBYCONFIG);

    if (!benchmark_rram_suite("default_rram")) {
        return 1;
    }

    /* Test Stine's recommendation: keep RRAMC awake / standby config */
    const uint32_t orig_lp = NRF_RRAMC->POWER.LOWPOWERCONFIG;
    const uint32_t orig_sb = NRF_RRAMC->POWER.STANDBYCONFIG;
    NRF_RRAMC->POWER.LOWPOWERCONFIG = 3u; /* Active / no power-off penalty */
    NRF_RRAMC->POWER.STANDBYCONFIG = 0u;
    __DSB();
    __ISB();

    if (!benchmark_rram_suite("tuned_rram")) {
        return 1;
    }

    NRF_RRAMC->POWER.LOWPOWERCONFIG = orig_lp;
    NRF_RRAMC->POWER.STANDBYCONFIG = orig_sb;

    PRINT("DONE,PASS,sink=%08x\n", (unsigned)output_sink);
    return 0;
#endif
}
```

## src/bench.h
```c
/* SPDX-License-Identifier: Apache-2.0 */
#ifndef S4_ROWTILING_BENCH_H
#define S4_ROWTILING_BENCH_H
#include <stdint.h>

struct bench_args {
    const int8_t *x;
    const int8_t *weights;
    const int32_t *bias;
    int8_t *out;
    int32_t rows;
    int32_t cols;
    int32_t input_offset;
    int32_t output_offset;
    int32_t multiplier;
    int32_t shift;
    int32_t activation_min;
    int32_t activation_max;
};

typedef void (*bench_kernel_fn)(const struct bench_args *);
int bench_check_unpack_all_u16(uint32_t *bad_input);
void bench_reference(const struct bench_args *p);
void bench_cmsis(const struct bench_args *p);
void bench_cmsis_u16_or(const struct bench_args *p);
void bench_tile1(const struct bench_args *p);
void bench_tile2(const struct bench_args *p);
void bench_tile2_u16_mask(const struct bench_args *p);
void bench_tile2_u16_or(const struct bench_args *p);
void bench_tile4(const struct bench_args *p);
void bench_tile4_u16_mask(const struct bench_args *p);
void bench_tile4_u16_or(const struct bench_args *p);
void bench_tile4_u16_or_nospill(const struct bench_args *p);
#endif
```

## src/kernels.c
```c
/* SPDX-License-Identifier: Apache-2.0 */
/*
 * Experiment v0.4:
 *   1. cmsis_u16_or: stock arm_nn_vec_mat_mult_t_s4 with ONLY read_and_pad_s4
 *      replaced by read_and_pad_s4_u16_or (4-line upstream helper patch).
 *   2. tile4_u16_or_nospill: 4-row tiling with row_bytes offset addressing and
 *      pointer-end loop bound to eliminate stack loads in the hot loop.
 */
#include <string.h>
#include "bench.h"
#include "arm_nnsupportfunctions.h"
#ifdef BENCH_HOST_TEST
#include "portable_dsp.h"
#else
#if !defined(ARM_MATH_DSP) || defined(ARM_MATH_MVEI)
#error "Expected the Cortex-M DSP path, without MVE"
#endif

__STATIC_FORCEINLINE void read_and_pad_s4_u16_mask(const int8_t *source,
                                                   int32_t *out1,
                                                   int32_t *out2)
{
    uint16_t packed;
    memcpy(&packed, source, sizeof(packed));
    int32_t inA = ((int32_t)packed & 0x00FF) | (((int32_t)packed & 0xFF00) << 8);

    *out1 = SXTB16_RORn(__sxtb16(inA << 4), 4);
    *out2 = SXTB16_RORn(__sxtb16(inA), 4);
}

__STATIC_FORCEINLINE void read_and_pad_s4_u16_or(const int8_t *source,
                                                 int32_t *out1,
                                                 int32_t *out2)
{
    uint16_t packed;
    memcpy(&packed, source, sizeof(packed));
    uint32_t inA = (uint32_t)packed | ((uint32_t)packed << 8);

    *out1 = SXTB16_RORn(__sxtb16((int32_t)(inA << 4)), 4);
    *out2 = SXTB16_RORn(__sxtb16((int32_t)inA), 4);
}
#endif

int bench_check_unpack_all_u16(uint32_t *bad_input)
{
    for (uint32_t v = 0; v < 65536u; ++v) {
        volatile uint16_t hv = (uint16_t)v;
        const uint16_t cur = hv;
        int8_t bytes[2];
        memcpy(bytes, &cur, sizeof(bytes));

        int32_t a1, a2, b1, b2, c1, c2;
        read_and_pad_s4(bytes, &a1, &a2);
        read_and_pad_s4_u16_mask(bytes, &b1, &b2);
        read_and_pad_s4_u16_or(bytes, &c1, &c2);

        if (a1 != b1 || a2 != b2 || a1 != c1 || a2 != c2) {
            if (bad_input) {
                *bad_input = v;
            }
            return 0;
        }
    }
    return 1;
}

static inline int8_t finish(int32_t acc, const struct bench_args *p)
{
    acc = arm_nn_requantize(acc, p->multiplier, p->shift);
    acc += p->output_offset;
    acc = MAX(acc, p->activation_min);
    acc = MIN(acc, p->activation_max);
    return (int8_t)acc;
}

static void scalar_rows(const struct bench_args *p, int32_t first)
{
    for (int32_t r = first; r < p->rows; ++r) {
        int32_t acc = p->bias ? p->bias[r] : 0;
        for (int32_t c = 0; c < p->cols; ++c) {
            const int32_t index = r * p->cols + c;
            const uint32_t byte = (uint8_t)p->weights[index / 2];
            const int32_t nibble = (byte >> (4 * (index & 1))) & 15;
            const int32_t weight = nibble < 8 ? nibble : nibble - 16;
            acc += ((int32_t)p->x[c] + p->input_offset) * weight;
        }
        p->out[r] = finish(acc, p);
    }
}

void bench_reference(const struct bench_args *p)
{
    scalar_rows(p, 0);
}

void bench_cmsis(const struct bench_args *p)
{
    (void)arm_nn_vec_mat_mult_t_s4(
        p->x, p->weights, p->bias, p->out, p->input_offset,
        p->output_offset, p->multiplier, p->shift, p->cols, p->rows,
        p->activation_min, p->activation_max);
}

#define ROW_MAC_A(pointer, accumulator) do { \
    int32_t weight_even, weight_odd; \
    read_and_pad_s4((pointer), &weight_even, &weight_odd); \
    (pointer) += 2; \
    (accumulator) = SMLAD(x_even, weight_even, (accumulator)); \
    (accumulator) = SMLAD(x_odd, weight_odd, (accumulator)); \
} while (0)

#define ROW_MAC_B(pointer, accumulator) do { \
    int32_t weight_even, weight_odd; \
    read_and_pad_s4_u16_mask((pointer), &weight_even, &weight_odd); \
    (pointer) += 2; \
    (accumulator) = SMLAD(x_even, weight_even, (accumulator)); \
    (accumulator) = SMLAD(x_odd, weight_odd, (accumulator)); \
} while (0)

#define ROW_MAC_C(pointer, accumulator) do { \
    int32_t weight_even, weight_odd; \
    read_and_pad_s4_u16_or((pointer), &weight_even, &weight_odd); \
    (pointer) += 2; \
    (accumulator) = SMLAD(x_even, weight_even, (accumulator)); \
    (accumulator) = SMLAD(x_odd, weight_odd, (accumulator)); \
} while (0)

#define LOAD_X() \
    int32_t x_word = arm_nn_read_s8x4_ia(&xp); \
    int32_t x_even = SXTAB16(offsets, x_word); \
    int32_t x_odd = SXTAB16_RORn(offsets, x_word, 8)

static inline uint32_t pack_offset(int32_t offset)
{
    const uint32_t half = (uint16_t)offset;
    return half | (half << 16);
}

void bench_tile1(const struct bench_args *p)
{
    if (p->cols % 4) {
        scalar_rows(p, 0);
        return;
    }
    const uint32_t offsets = pack_offset(p->input_offset);
    for (int32_t r = 0; r < p->rows; ++r) {
        const int8_t *xp = p->x;
        const int8_t *w0 = p->weights + r * (p->cols / 2);
        int32_t acc0 = p->bias ? p->bias[r] : 0;
        for (int32_t c = 0; c < p->cols; c += 4) {
            LOAD_X();
            ROW_MAC_A(w0, acc0);
        }
        p->out[r] = finish(acc0, p);
    }
}

void bench_tile2(const struct bench_args *p)
{
    if (p->cols % 4) {
        scalar_rows(p, 0);
        return;
    }
    const uint32_t offsets = pack_offset(p->input_offset);
    int32_t r = 0;
    for (; r + 2 <= p->rows; r += 2) {
        const int8_t *xp = p->x;
        const int8_t *w0 = p->weights + r * (p->cols / 2);
        const int8_t *w1 = w0 + p->cols / 2;
        int32_t acc0 = p->bias ? p->bias[r] : 0;
        int32_t acc1 = p->bias ? p->bias[r + 1] : 0;
        for (int32_t c = 0; c < p->cols; c += 4) {
            LOAD_X();
            ROW_MAC_A(w0, acc0);
            ROW_MAC_A(w1, acc1);
        }
        p->out[r] = finish(acc0, p);
        p->out[r + 1] = finish(acc1, p);
    }
    scalar_rows(p, r);
}

void bench_tile2_u16_mask(const struct bench_args *p)
{
    if (p->cols % 4) {
        scalar_rows(p, 0);
        return;
    }
    const uint32_t offsets = pack_offset(p->input_offset);
    int32_t r = 0;
    for (; r + 2 <= p->rows; r += 2) {
        const int8_t *xp = p->x;
        const int8_t *w0 = p->weights + r * (p->cols / 2);
        const int8_t *w1 = w0 + p->cols / 2;
        int32_t acc0 = p->bias ? p->bias[r] : 0;
        int32_t acc1 = p->bias ? p->bias[r + 1] : 0;
        for (int32_t c = 0; c < p->cols; c += 4) {
            LOAD_X();
            ROW_MAC_B(w0, acc0);
            ROW_MAC_B(w1, acc1);
        }
        p->out[r] = finish(acc0, p);
        p->out[r + 1] = finish(acc1, p);
    }
    scalar_rows(p, r);
}

void bench_tile2_u16_or(const struct bench_args *p)
{
    if (p->cols % 4) {
        scalar_rows(p, 0);
        return;
    }
    const uint32_t offsets = pack_offset(p->input_offset);
    int32_t r = 0;
    for (; r + 2 <= p->rows; r += 2) {
        const int8_t *xp = p->x;
        const int8_t *w0 = p->weights + r * (p->cols / 2);
        const int8_t *w1 = w0 + p->cols / 2;
        int32_t acc0 = p->bias ? p->bias[r] : 0;
        int32_t acc1 = p->bias ? p->bias[r + 1] : 0;
        for (int32_t c = 0; c < p->cols; c += 4) {
            LOAD_X();
            ROW_MAC_C(w0, acc0);
            ROW_MAC_C(w1, acc1);
        }
        p->out[r] = finish(acc0, p);
        p->out[r + 1] = finish(acc1, p);
    }
    scalar_rows(p, r);
}

void bench_tile4(const struct bench_args *p)
{
    if (p->cols % 4) {
        scalar_rows(p, 0);
        return;
    }
    const uint32_t offsets = pack_offset(p->input_offset);
    int32_t r = 0;
    for (; r + 4 <= p->rows; r += 4) {
        const int8_t *xp = p->x;
        const int8_t *w0 = p->weights + r * (p->cols / 2);
        const int8_t *w1 = w0 + p->cols / 2;
        const int8_t *w2 = w1 + p->cols / 2;
        const int8_t *w3 = w2 + p->cols / 2;
        int32_t acc0 = p->bias ? p->bias[r] : 0;
        int32_t acc1 = p->bias ? p->bias[r + 1] : 0;
        int32_t acc2 = p->bias ? p->bias[r + 2] : 0;
        int32_t acc3 = p->bias ? p->bias[r + 3] : 0;
        for (int32_t c = 0; c < p->cols; c += 4) {
            LOAD_X();
            ROW_MAC_A(w0, acc0);
            ROW_MAC_A(w1, acc1);
            ROW_MAC_A(w2, acc2);
            ROW_MAC_A(w3, acc3);
        }
        p->out[r] = finish(acc0, p);
        p->out[r + 1] = finish(acc1, p);
        p->out[r + 2] = finish(acc2, p);
        p->out[r + 3] = finish(acc3, p);
    }
    scalar_rows(p, r);
}

void bench_tile4_u16_mask(const struct bench_args *p)
{
    if (p->cols % 4) {
        scalar_rows(p, 0);
        return;
    }
    const uint32_t offsets = pack_offset(p->input_offset);
    int32_t r = 0;
    for (; r + 4 <= p->rows; r += 4) {
        const int8_t *xp = p->x;
        const int8_t *w0 = p->weights + r * (p->cols / 2);
        const int8_t *w1 = w0 + p->cols / 2;
        const int8_t *w2 = w1 + p->cols / 2;
        const int8_t *w3 = w2 + p->cols / 2;
        int32_t acc0 = p->bias ? p->bias[r] : 0;
        int32_t acc1 = p->bias ? p->bias[r + 1] : 0;
        int32_t acc2 = p->bias ? p->bias[r + 2] : 0;
        int32_t acc3 = p->bias ? p->bias[r + 3] : 0;
        for (int32_t c = 0; c < p->cols; c += 4) {
            LOAD_X();
            ROW_MAC_B(w0, acc0);
            ROW_MAC_B(w1, acc1);
            ROW_MAC_B(w2, acc2);
            ROW_MAC_B(w3, acc3);
        }
        p->out[r] = finish(acc0, p);
        p->out[r + 1] = finish(acc1, p);
        p->out[r + 2] = finish(acc2, p);
        p->out[r + 3] = finish(acc3, p);
    }
    scalar_rows(p, r);
}

void bench_tile4_u16_or(const struct bench_args *p)
{
    if (p->cols % 4) {
        scalar_rows(p, 0);
        return;
    }
    const uint32_t offsets = pack_offset(p->input_offset);
    int32_t r = 0;
    for (; r + 4 <= p->rows; r += 4) {
        const int8_t *xp = p->x;
        const int8_t *w0 = p->weights + r * (p->cols / 2);
        const int8_t *w1 = w0 + p->cols / 2;
        const int8_t *w2 = w1 + p->cols / 2;
        const int8_t *w3 = w2 + p->cols / 2;
        int32_t acc0 = p->bias ? p->bias[r] : 0;
        int32_t acc1 = p->bias ? p->bias[r + 1] : 0;
        int32_t acc2 = p->bias ? p->bias[r + 2] : 0;
        int32_t acc3 = p->bias ? p->bias[r + 3] : 0;
        for (int32_t c = 0; c < p->cols; c += 4) {
            LOAD_X();
            ROW_MAC_C(w0, acc0);
            ROW_MAC_C(w1, acc1);
            ROW_MAC_C(w2, acc2);
            ROW_MAC_C(w3, acc3);
        }
        p->out[r] = finish(acc0, p);
        p->out[r + 1] = finish(acc1, p);
        p->out[r + 2] = finish(acc2, p);
        p->out[r + 3] = finish(acc3, p);
    }
    scalar_rows(p, r);
}

void bench_tile4_u16_or_nospill(const struct bench_args *p)
{
    if (p->cols % 4 || p->cols <= 0) {
        scalar_rows(p, 0);
        return;
    }
    const uint32_t offsets = pack_offset(p->input_offset);
    const int32_t row_bytes = p->cols >> 1;
    int32_t r = 0;
    for (; r + 4 <= p->rows; r += 4) {
        const int8_t *xp = p->x;
        const int8_t *const xp_end = xp + p->cols;
        const int8_t *w0 = p->weights + r * row_bytes;
        const int8_t *w2 = w0 + 2 * row_bytes;
        int32_t acc0 = p->bias ? p->bias[r] : 0;
        int32_t acc1 = p->bias ? p->bias[r + 1] : 0;
        int32_t acc2 = p->bias ? p->bias[r + 2] : 0;
        int32_t acc3 = p->bias ? p->bias[r + 3] : 0;
        do {
            LOAD_X();
            int32_t we, wo;
            read_and_pad_s4_u16_or(w0, &we, &wo);
            acc0 = SMLAD(x_even, we, acc0);
            acc0 = SMLAD(x_odd, wo, acc0);

            read_and_pad_s4_u16_or(w0 + row_bytes, &we, &wo);
            w0 += 2;
            acc1 = SMLAD(x_even, we, acc1);
            acc1 = SMLAD(x_odd, wo, acc1);

            read_and_pad_s4_u16_or(w2, &we, &wo);
            acc2 = SMLAD(x_even, we, acc2);
            acc2 = SMLAD(x_odd, wo, acc2);

            read_and_pad_s4_u16_or(w2 + row_bytes, &we, &wo);
            w2 += 2;
            acc3 = SMLAD(x_even, we, acc3);
            acc3 = SMLAD(x_odd, wo, acc3);
        } while (xp < xp_end);
        p->out[r] = finish(acc0, p);
        p->out[r + 1] = finish(acc1, p);
        p->out[r + 2] = finish(acc2, p);
        p->out[r + 3] = finish(acc3, p);
    }
    scalar_rows(p, r);
}

#define read_and_pad_s4 read_and_pad_s4_u16_or
#define arm_nn_vec_mat_mult_t_s4 arm_nn_vec_mat_mult_t_s4_u16_or
#include "arm_nn_vec_mat_mult_t_s4.c"
#undef arm_nn_vec_mat_mult_t_s4
#undef read_and_pad_s4

void bench_cmsis_u16_or(const struct bench_args *p)
{
    (void)arm_nn_vec_mat_mult_t_s4_u16_or(
        p->x, p->weights, p->bias, p->out, p->input_offset,
        p->output_offset, p->multiplier, p->shift, p->cols, p->rows,
        p->activation_min, p->activation_max);
}
```
